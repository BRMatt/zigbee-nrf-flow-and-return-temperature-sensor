## Code/KConfig
```kconfig
# /Kconfig
# this is all you need!
source "Kconfig.zephyr"

menu "FART Sensor"

config REFERENCE_VOLTAGE
	int "The reference voltage"
	range 3000 5000
	default 3300

config SWAP_PROBES_PRESS_TIME_SECONDS
	int "The time the reset button must be pressed to swap the probes"
	range 2 19
	default 5

config FART_SCREEN
	bool "Show probe readings on an SSD1306 screen"
	depends on DISPLAY
	select CHARACTER_FRAMEBUFFER
	help
	  Shows the temperature and resistance of both probes on the OLED of
	  the Seeed Expansion Base for XIAO. See xiao_expansion_base.conf.

endmenu
```
